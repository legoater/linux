## Documentation/devicetree/bindings/spi/openpower,microwatt-spi.txt
```
# SPDX-License-Identifier: (GPL-2.0-only OR BSD-2-Clause)
%YAML 1.2
---
$id: http://devicetree.org/schemas/spi/openpower,microwatt-spi.yaml#
$schema: http://devicetree.org/meta-schemas/core.yaml#

title: Microwatt SPI Flash Controller

maintainers:
  - Noname

allOf:
  - $ref: "spi-controller.yaml#"

properties:
  compatible:
    enum:
      - openpower,microwatt-spi

  reg:
    maxItems: 1

required:
  - compatible
  - reg

unevaluatedProperties: false

examples:
  - |
    spi@6000 {
       compatible = "openpower,microwatt-spi";
       reg = <0x6000     0x100
              0x30000000 0x8000000 >;
       #address-cells = <1>;
       #size-cells = <0>;
    };
```

## drivers/vfio/pci/e1000e/Kconfig
```kconfig
# SPDX-License-Identifier: GPL-2.0

config E1000E_VFIO_PCI
	tristate "Generic VFIO PCI extensions for e1000e ethernet adapters"
	default y
	help
	  Support for Intel E1000E specific extensions to enable direct
	  assignment to virtual machines.

	  To enable Intel E1000E assignment through vfio-pci-e1000e, say Y.
```
