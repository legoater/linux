## drivers/platform/nvidia/Kconfig
```kconfig
# SPDX-License-Identifier: GPL-2.0-only
config NVGRACE_EGM
	tristate "EGM driver for NVIDIA Grace Hopper and Blackwell Superchip"
	depends on ARM64 || (COMPILE_TEST && 64BIT)
	help
	  Extended GPU Memory (EGM) support for the GPU in the NVIDIA Grace
	  based chips required to avail the CPU memory as additional
	  cross-node/cross-socket memory for GPU using KVM/qemu.

	  If you don't know what to do here, say N.
```

## drivers/vfio/pci/cxl/Kconfig
```kconfig
# SPDX-License-Identifier: GPL-2.0-only
config VFIO_CXL
	tristate "VFIO support for CXL Type-2 devices"
	depends on CXL_BUS && CXL_MEM
	select VFIO_PCI_CORE
	help
	  Add CXL HDM handling to vfio-pci so a CXL Type-2 device, such as a
	  CXL-attached accelerator, can be assigned to a virtual machine.
	  vfio-pci loads this module on demand when it binds a CXL device.

	  If you don't know what to do here, say N.
```

## drivers/vfio/pci/igb/Kconfig
```kconfig
# SPDX-License-Identifier: GPL-2.0

config IGB_VFIO_PCI
	tristate "VFIO PCI live migration support for Intel 82576 (igbvf) VF"
	select VFIO_PCI_CORE
	default n
	help
	  VFIO PCI variant driver for the Intel 82576 (igbvf) virtual
	  function with live migration support (stop-copy and pre-copy).

	  The driver communicates with the emulated PF through a DVSEC
	  capability in VF extended config space to support migration.
	  It is intended for nested virtualization with QEMU's igb
	  device model.

	  If you don't know what to do here, say N.
```
